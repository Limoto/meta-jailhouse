## conf/layer.conf
```bitbake
# We have a conf and classes directory, add to BBPATH
BBPATH .= ":${LAYERDIR}"

# We have recipes-* directories, add to BBFILES
BBFILES += "${LAYERDIR}/recipes-*/*/*.bb \
            ${LAYERDIR}/recipes-*/*/*.bbappend"

BBFILE_COLLECTIONS += "meta-jailhouse"
BBFILE_PATTERN_meta-jailhouse = "^${LAYERDIR}/"
BBFILE_PRIORITY_meta-jailhouse = "6"

LAYERDEPENDS_meta-jailhouse = "core"
LAYERRECOMMENDS_meta-jailhouse = "meta-raspberrypi"

LAYERSERIES_COMPAT_meta-jailhouse = "gatesgarth"

BBFILES_DYNAMIC += " \
    raspberrypi:${LAYERDIR}/dynamic-layers/raspberrypi/*/*/*.bbappend \
"
```

## meta-agl-jailhouse-raspberrypi/conf/layer.conf
```bitbake
# We have a conf and classes directory, append to BBPATH
BBPATH .= ":${LAYERDIR}"

# We have a recipes directory, add to BBFILES
BBFILES += "${LAYERDIR}/recipes*/*/*.bb ${LAYERDIR}/recipes*/*/*.bbappend"

BBFILE_COLLECTIONS += "agl-jailhouse-raspberrypi"
BBFILE_PATTERN_agl-jailhouse-raspberrypi := "^${LAYERDIR}/"
BBFILE_PRIORITY_agl-jailhouse-raspberrypi = "61"

# This should only be incremented on significant changes that will
# cause compatibility issues with other layers
LAYERVERSION_agl-jailhouse-raspberrypi = "1"
LAYERSERIES_COMPAT_agl-jailhouse-raspberrypi = "zeus dunfell"

LAYERDEPENDS_agl-jailhouse-raspberrypi = " \
    meta-arm \
    agl-jailhouse \
"
```
